&i2c1 {
    pinctrl-0 = < &i2c1_scl_pb6 &i2c1_sda_pb7 >;
    status = "okay";

		lis3dh@19 {
		compatible = "st,lis3dh", "st,lis2dh";
		reg = <0x19>;
		irq-gpios = <&gpiob 8 GPIO_ACTIVE_HIGH>,
		<&gpiob 9 GPIO_ACTIVE_HIGH>;
		label = "LIS3DH";
	};
};